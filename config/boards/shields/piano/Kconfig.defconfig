## config/boards/shields/piano/Kconfig.defconfig
```kconfig
config ZMK_BLE
    default y

config ZMK_USB
    default y

config ZMK_SPLIT
    default y

if SHIELD_PIANO_DONGLE 

config ZMK_KEYBOARD_NAME
    default "The Piano"

config ZMK_SPLIT_BLE_ROLE_CENTRAL
    default y

endif

if SHIELD_PIANO_DONGLE_LEFT || SHIELD_PIANO_DONGLE_RIGHT

config ZMK_SLEEP
    default y
    
endif
```
